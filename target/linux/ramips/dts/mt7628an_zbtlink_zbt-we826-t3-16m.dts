#include "mt7628an_zbtlink_zbt-we826-t3.dtsi"

/ {
	compatible = "zbtlink,zbt-we826-t3-16m", "zbtlink,zbt-we826-t3", "mediatek,mt7621-soc";
	model = "Zbtlink ZBT-WE826-T3 (16M)";
};

&firmware {
	reg = <0x50000 0xfb0000>;
};
