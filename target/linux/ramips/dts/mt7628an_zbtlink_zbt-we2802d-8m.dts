#include "mt7628an_zbtlink_zbt-we2802d.dtsi"

/ {
	compatible = "zbtlink,zbt-we2802d-8m", "zbtlink,zbt-we2802d", "mediatek,mt7628an-soc";
	model = "ZBT-WE2802D (8M)";
};

&firmware {
	reg = <0x50000 0x7b0000>;
};


