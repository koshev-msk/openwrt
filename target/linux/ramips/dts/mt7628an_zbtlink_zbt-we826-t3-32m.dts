#include "mt7628an_zbtlink_zbt-we826-t3.dtsi"

/ {
	compatible = "zbtlink,zbt-we826-t3-32m", "zbtlink,zbt-we826-t3", "mediatek,mt7621-soc";
	model = "Zbtlink ZBT-WE826-T3 (32M)";
};

&firmware {
	reg = <0x50000 0x1fb0000>;
};
