#include "mt7628an_zbtlink_zbt-cpe2801.dtsi"

/ {
	compatible = "zbtlink,zbt-cpe2801-16m", "zbtlink,zbt-cpe2801", "mediatek,mt7628an-soc";
	model = "Zbtlink ZBT-CPE2801 (16M)";
};

&firmware {
	reg = <0x50000 0xfb0000>;
};
