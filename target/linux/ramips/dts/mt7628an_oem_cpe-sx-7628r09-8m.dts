#include "mt7628an_oem_cpe-sx-7628r09.dtsi"

/ {
	compatible = "oem,cpe-sx-7628r09-8m", "oem,cpe-sx-7628r09", "mediatek,mt7628an-soc";
	model = "CPE SX-7628R09 (8M)";
};

&firmware {
	reg = <0x50000 0x790000>;
};
