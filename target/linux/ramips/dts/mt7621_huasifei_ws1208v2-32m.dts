// SPDX-License-Identifier: GPL-2.0-or-later OR MIT

#include "mt7621_huasifei_ws1208v2.dtsi"

/ {
	compatible = "huasifei,ws1208v2", "huasifei,ws1208v2-32m", "mediatek,mt7621-soc";
	model = "Huasifei WS1208V2 (32M)";
};

&firmware {
	reg = <0x50000 0x1fb0000>;
};
