// SPDX-License-Identifier: GPL-2.0-or-later OR MIT

#include "mt7621_huasifei_ws1208v2.dtsi"

/ {
	compatible = "huasifei,ws1208v2-16m", "huasifei,ws1208v2", "mediatek,mt7621-soc";
	model = "Huasifei WS1208V2 (16M)";
};

&firmware {
	reg = <0x50000 0xfb0000>;
};
