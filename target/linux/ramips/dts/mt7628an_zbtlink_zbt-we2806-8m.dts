// SPDX-License-Identifier: GPL-2.0-or-later OR MIT

#include "mt7628an_zbtlink_zbt-we2806.dtsi"

/ {
	compatible = "zbtlink,zbt-we2806-8m", "zbtlink,zbt-we2806", "mediatek,mt7628an-soc";
	model = "Zbtlink ZBT-WE2806 (8M)";
};

&firmware {
	reg = <0x50000 0x7b0000>;
};
