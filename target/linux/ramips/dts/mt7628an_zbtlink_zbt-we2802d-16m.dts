#include "mt7628an_zbtlink_zbt-we2802d.dtsi"

/ {
	compatible = "zbtlink,zbt-we2802d-16m", "zbtlink,zbt-we2802d", "mediatek,mt7621-soc";
	model = "Zbtlink ZBT-WE2802D (16M)";
};

&firmware {
	reg = <0x50000 0xfb0000>;
};
