// SPDX-License-Identifier: GPL-2.0-or-later OR MIT

#include "mt7981b-zbtlink-zbt-z8109ax-nand.dtsi"

/ {
	model = "Zbtlink ZBT-Z8109AX (ALL nAND)";
	compatible = "zbtlink,zbt-z8109ax-nand-all", "zbtlink,zbt-z8109ax-nand", "zbtlink,zbt-z8109ax", "mediatek,mt7981";

};

// use all allocated ubi size up to 512M
// mtdparts=nmbm0:1024k(bl2),512k(u-boot-env),2048k(factory),2048k(fip),524288k(ubi)

&firmware {
	reg = <0x580000 0x20000000>;
};

