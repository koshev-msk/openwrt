// SPDX-License-Identifier: GPL-2.0-or-later OR MIT

#include "mt7981b-zbtlink-zbt-z8102ax-nand.dtsi"

/ {
	model = "ZBT Z8102AX (nAND ALL)";
	compatible = "zbtlink,zbt-z8102ax-nand-all", "zbtlink,zbt-z8102ax-nand", "zbtlink,zbt-z8102ax", "mediatek,mt7981";
};

&firmware {
	reg = <0x0580000 0x20000000>;
};
