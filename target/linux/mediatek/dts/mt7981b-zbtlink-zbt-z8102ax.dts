// SPDX-License-Identifier: GPL-2.0-or-later OR MIT

/dts-v1/;

#include "mt7981b-zbtlink-zbt-z8102ax-nand.dtsi"

/ {
	model = "Zbtlink ZBT-Z8102AX";
	compatible = "zbtlink,zbt-z8102ax", "mediatek,mt7981";
};
